## boards/shields/mapadubu/Kconfig.def
```kconfig
#
# Copyright (c) 2024 The ZMK Contributors
#
# SPDX-License-Identifier: MIT
#

config ZMK_SHIELD_MAPADUBU_LEFT
    bool "mapadubu_left"
    depends on SOC_NRF52840

config ZMK_SHIELD_MAPADUBU_RIGHT
    bool "mapadubu_right"
    depends on SOC_NRF52840
```

## boards/shields/mapadubu/Kconfig.defconfig
```kconfig
# Copyright (c) 2022 The ZMK Contributors
# SPDX-License-Identifier: MIT

if SHIELD_MAPADUBU_LEFT

config ZMK_KEYBOARD_NAME
    default "MAPADUBU ZMK"
    
config ZMK_SPLIT_ROLE_CENTRAL
    default y

endif

if SHIELD_MAPADUBU_LEFT || SHIELD_MAPADUBU_RIGHT

config ZMK_SPLIT
    default y

endif
```

## boards/shields/mapadubu/Kconfig.shield
```kconfig
# Copyright (c) 2022 The ZMK Contributors
# SPDX-License-Identifier: MIT

config SHIELD_MAPADUBU_LEFT
    def_bool $(shields_list_contains,mapadubu_left)

config SHIELD_MAPADUBU_RIGHT
    def_bool $(shields_list_contains,mapadubu_right)
```
