/*
 * Copyright (c) 2022 The ZMK Contributors
 *
 * SPDX-License-Identifier: MIT
 */

#include "mapadubu.dtsi"

&kscan0 {
    col-gpios
	    = <&gpio0 2 (GPIO_ACTIVE_HIGH | GPIO_PULL_DOWN)>
        , <&gpio0 3 (GPIO_ACTIVE_HIGH | GPIO_PULL_DOWN)>
        , <&gpio0 28 (GPIO_ACTIVE_HIGH | GPIO_PULL_DOWN)>
        , <&gpio0 29 (GPIO_ACTIVE_HIGH | GPIO_PULL_DOWN)>
        , <&gpio0 4 (GPIO_ACTIVE_HIGH | GPIO_PULL_DOWN)>
        ;
};
